## zephyr_build/drivers/Kconfig
```kconfig
# Copyright (c) 2023 Beechwoods Software Inc.
# SPDX-License-Identifier: Apache-2.0

menu "Drivers"
rsource "wifi/Kconfig"
endmenu
```

## zephyr_build/drivers/wifi/Kconfig
```kconfig
# Copyright (c) 2023 Beechwoods Software, Inc
# SPDX-License-Identifier: Apache-2.0

if WIFI
rsource "zephyr_cyw43/Kconfig.rpi_pico_w"
endif # WIFI
```

## zephyr_build/drivers/wifi/zephyr_cyw43/Kconfig.rpi_pico_w
```kconfig
# Raspberry Pi Pico W WiFi driver options

# Copyright (c) 2023 Beechwoods Software
# SPDX-License-Identifier: Apache-2.0

menuconfig WIFI_ZEPHYR_CYW43
	bool "Infineon CYW43 Wifi support"
	default y
	select NET_L2_WIFI_MGMT
	select WIFI_USE_NATIVE_NETWORKING

	select GPIO
	#select SPI
	#select SPI_RPI_PICO_PIO	
        select PICOSDK_USE_PIO # This can be removed once Zephyr PIO-SPI works
	
#if WIFI_ZEPHYR_CYW43
config WIFI_ZEPHYR_CYW43_SHELL
	bool "CYW43 shell"
	depends on SHELL
	help
	  Enable CYW43 shell

config WIFI_CYW43_USE_CYW4343W
	bool "Use Infineon CYW4343W chip"
	help
		Use firmware for the CYW4343W chip in place of
		the CYW43439 on the Raspberry Pi Pico W.

config USE_PICOWI_PIOSPI
        bool "Use picowi PIO-SPI, but nothing else"
	default n

config LED_INIT_PRIORITY
    int "Wifi led driver init priority"
    default 80

# Power Save params

config WIFI_ZEPHYR_CYW43_POWERSAVE_MODE
	int "Powersave Mode (0 - off, 1 - PM1(aggressive), 2 - PM2(perfomrance)"
	range 0 2
	default 0
	help
	  This chooses the basic powersave mode of the cyw43. PM1 saves more power, but
	  reduces throughput. PM2 doesn't significantly reduce throughput.

config WIFI_ZEPHYR_CYW43_POWERSAVE_PM2_SLEEP_RET_MS
	int "Powersave sleep return time (0-255 x 10ms)"
	range 0 255
	default 200
	help
	   The maximum time to wait before going back to sleep for CYW43_PM2_POWERSAVE_MODE mode.

config WIFI_ZEPHYR_CYW43_POWERSAVE_LI_BEACON_PERIOD
	int "Wake period (0-15)"
	range 0 15
	default 1
	help
	   Wake period is measured in beacon period.

config WIFI_ZEPHYR_CYW43_POWERSAVE_LI_DTIM_PERIOD
	int "Wake period (0-15)"
	range 0 15
	default 1
	help
	   Wake interval measured in DTIMs. If this is set to 0, the wake interval is measured in beacon periods.

config WIFI_ZEPHYR_CYW43_POWERSAVE_LI_ASSOC
	int "Wake interval (0-15)"
	range 0 15
	default 10
	help
	   Wake interval sent to the access point.


#endif
```

## zephyr_build/dts/bindings/zephyr_cyw43/infineon,cyw43.yaml
```yaml
# Copyright (c) 2023, Beechwoods Software, Inc
# SPDX-License-Identifier: Apache-2.0

description: Infineon CYW43 module

compatible: "infineon,cyw43"

include: spi-device.yaml

properties:
  spi-max-frequency:
    type: int
    required: true

  wl-on-gpios:
    type: phandle-array

  host-wake-gpios:
    description: |
      "interrupt" gpio. Signal from the Infineon module to the host
      that an event has occurred.
    type: phandle-array
```

## zephyr_build/west.yml
```yaml
# Copyright (c) 2023 Nordic Beechwoods Software, Inc.
# SPDX-License-Identifier: Apache-2.0

manifest:
  #self:
  #  west-commands: scripts/west-commands.yml
  defaults:
    remote: zephyrproject-rtos
    
  remotes:
    - name: zephyrproject-rtos
      url-base: https://github.com/zephyrproject-rtos

  projects:
    - name: zephyr
      remote: zephyrproject-rtos
      revision: main
      import:
        # By using name-allowlist we can clone only the modules that are
        # strictly needed by the application.
        name-allowlist:
          - cmsis      # required by the ARM port
          - hal_rpi_pico
          - mbedtls
```
